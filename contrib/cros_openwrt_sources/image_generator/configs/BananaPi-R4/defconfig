## contrib/cros_openwrt_sources/image_generator/configs/BananaPi-R4/defconfig
```kconfig
CONFIG_TARGET_DEVICE_mediatek_filogic_DEVICE_bananapi_bpi-r4=y
# CONFIG_TARGET_DEVICE_mediatek_filogic_DEVICE_bananapi_bpi-r4-poe is not set
# CONFIG_TARGET_DEVICE_mediatek_filogic_DEVICE_bananapi_bpi-r4-lite is not set
# CONFIG_TARGET_DEVICE_mediatek_filogic_DEVICE_bananapi_bpi-r4-mini is not set
# CONFIG_TARGET_DEVICE_mediatek_filogic_DEVICE_bananapi_bpi-r4-pro is not set
# CONFIG_TARGET_DEVICE_mediatek_filogic_DEVICE_mediatek_mt7981-rfb is not set
# CONFIG_TARGET_DEVICE_mediatek_filogic_DEVICE_mediatek_mt7986a-rfb is not set
# CONFIG_TARGET_DEVICE_mediatek_filogic_DEVICE_mediatek_mt7986b-rfb is not set
# CONFIG_TARGET_DEVICE_mediatek_filogic_DEVICE_mediatek_mt7987a-rfb is not set
# CONFIG_TARGET_DEVICE_mediatek_filogic_DEVICE_mediatek_mt7988a-rfb is not set
# CONFIG_TARGET_DEVICE_mediatek_filogic_DEVICE_mediatek_mt7988d-rfb is not set

# CONFIG_PACKAGE_mt7981-wo-firmware is not set
# CONFIG_PACKAGE_mt7986-wo-firmware is not set
CONFIG_PACKAGE_mt7988-wo-firmware=y
CONFIG_PACKAGE_kmod-mt76qos=y
# CONFIG_PACKAGE_kmod-mt7915e is not set
# CONFIG_PACKAGE_kmod-mt7981-firmware is not set
# CONFIG_PACKAGE_kmod-mt7986-firmware is not set
# CONFIG_PACKAGE_kmod-mt7990-firmware is not set
# CONFIG_PACKAGE_kmod-mt7992-23-firmware is not set
# CONFIG_PACKAGE_kmod-mt7992-firmware is not set
CONFIG_PACKAGE_kmod-mt7996-233-firmware=y
CONFIG_PACKAGE_kmod-mt7996-firmware=y

# CONFIG_PACKAGE_dropbear is not set
CONFIG_PACKAGE_sudo=y
CONFIG_PACKAGE_python3-idna=y
CONFIG_PACKAGE_python3-urllib=y
CONFIG_PACKAGE_rsync=y
CONFIG_PACKAGE_openssh-server=y
CONFIG_WPA_ENABLE_WEP=y
CONFIG_PACKAGE_cros-iperf=y
CONFIG_PACKAGE_iputils-arping=y
CONFIG_PACKAGE_iputils-ping=y
CONFIG_PACKAGE_cros-send-management-frame=y
CONFIG_PACKAGE_procps-ng=y
CONFIG_PACKAGE_procps-ng-pkill=y
CONFIG_DRIVER_11AC_SUPPORT=y
CONFIG_DRIVER_11AX_SUPPORT=y
CONFIG_WPA_MBO_SUPPORT=y
CONFIG_PACKAGE_tcpdump=y
CONFIG_PACKAGE_tar=y
CONFIG_PACKAGE_xz-utils=y
CONFIG_PACKAGE_iperf3=y
CONFIG_BUSYBOX_CUSTOM=y
CONFIG_BUSYBOX_CONFIG_TIMEOUT=y
CONFIG_PACKAGE_libopenssl=y
CONFIG_PACKAGE_libopenssl-conf=y
CONFIG_PACKAGE_libopenssl-legacy=y
CONFIG_PACKAGE_kmod-veth=y

# Prune unused PHY/crypto drivers, firmware, services, and utilities inherited
# from upstream platform defconfigs.
# CONFIG_PACKAGE_airoha-phy-firmware is not set
# CONFIG_PACKAGE_airoha-en8811h-firmware is not set
# CONFIG_PACKAGE_aqr10g-phy-firmware is not set
# CONFIG_PACKAGE_as21xxx-firmware is not set
# CONFIG_PACKAGE_kmod-mt798x-2p5g-phy is not set
# CONFIG_PACKAGE_mt798x-2p5g-phy-firmware-internal is not set
# CONFIG_PACKAGE_kmod-phy-air_an8811hb is not set
# CONFIG_PACKAGE_kmod-phy-airoha-an8801sb is not set
# CONFIG_PACKAGE_kmod-phy-airoha-en8811h is not set
# CONFIG_PACKAGE_kmod-phy-aquantia is not set
# CONFIG_PACKAGE_kmod-phy-marvell is not set
# CONFIG_PACKAGE_kmod-phy-marvell-10g is not set
# CONFIG_PACKAGE_kmod-crypto-hw-safexcel is not set
# CONFIG_PACKAGE_eip197-mini-firmware is not set
# CONFIG_PACKAGE_kmod-crypto-eip is not set
# CONFIG_CRYPTO_OFFLOAD_INLINE_FLOWBLOCK is not set
# CONFIG_PACKAGE_luci is not set
# CONFIG_PACKAGE_luci-app-ksmbd is not set
# CONFIG_PACKAGE_ksmbd-server is not set
# CONFIG_PACKAGE_wsdd2 is not set
# CONFIG_PACKAGE_luci-app-omcproxy is not set
# CONFIG_PACKAGE_luci-proto-relay is not set
# CONFIG_PACKAGE_relayd is not set
# CONFIG_PACKAGE_pptpd is not set
# CONFIG_PACKAGE_xl2tpd is not set
# CONFIG_PACKAGE_ppp is not set
# CONFIG_PACKAGE_ppp-mod-pppoe is not set
# CONFIG_PACKAGE_ppp-mod-pppol2tp is not set
# CONFIG_PACKAGE_ppp-mod-pptp is not set
# CONFIG_PACKAGE_perf is not set
# CONFIG_PACKAGE_objdump is not set
# CONFIG_PACKAGE_ephy-utils is not set
# CONFIG_PACKAGE_switch is not set
# CONFIG_PACKAGE_mii_mgr is not set
# CONFIG_PACKAGE_regs is not set
# CONFIG_PACKAGE_mtk_factory_rw is not set
# CONFIG_PACKAGE_mtkhnat_util is not set
# CONFIG_PACKAGE_netfilter-flowtable is not set
# CONFIG_PACKAGE_netsys_dbg_util is not set
# CONFIG_PACKAGE_smp_util is not set
# CONFIG_PACKAGE_atenl is not set
# CONFIG_PACKAGE_quick_track is not set
# CONFIG_PACKAGE_mt76-test is not set
# CONFIG_PACKAGE_fio is not set
# CONFIG_PACKAGE_sfdisk is not set
# CONFIG_PACKAGE_iio-utils is not set
# CONFIG_PACKAGE_avahi-dbus-daemon is not set
# CONFIG_PACKAGE_dbus is not set
```
