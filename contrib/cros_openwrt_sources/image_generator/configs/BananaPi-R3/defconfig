## contrib/cros_openwrt_sources/image_generator/configs/BananaPi-R3/defconfig
```kconfig
CONFIG_TARGET_mediatek=y
CONFIG_TARGET_mediatek_filogic=y
CONFIG_TARGET_mediatek_filogic_DEVICE_bananapi_bpi-r3=y
CONFIG_OPENSSH_LIBFIDO2=y
CONFIG_OPENSSL_ENGINE=y
CONFIG_OPENSSL_WITH_ASM=y
CONFIG_OPENSSL_WITH_CHACHA_POLY1305=y
CONFIG_OPENSSL_WITH_CMS=y
CONFIG_OPENSSL_WITH_DEPRECATED=y
CONFIG_OPENSSL_WITH_ERROR_MESSAGES=y
CONFIG_OPENSSL_WITH_IDEA=y
CONFIG_OPENSSL_WITH_MDC2=y
CONFIG_OPENSSL_WITH_PSK=y
CONFIG_OPENSSL_WITH_SEED=y
CONFIG_OPENSSL_WITH_SRP=y
CONFIG_OPENSSL_WITH_TLS13=y
CONFIG_OPENSSL_WITH_WHIRLPOOL=y
CONFIG_PACKAGE_TAR_BZIP2=y
CONFIG_PACKAGE_TAR_GZIP=y
CONFIG_PACKAGE_TAR_POSIX_ACL=y
CONFIG_PACKAGE_TAR_XATTR=y
CONFIG_PACKAGE_TAR_XZ=y
CONFIG_PACKAGE_TAR_ZSTD=y
CONFIG_PACKAGE_bzip2=y
CONFIG_PACKAGE_dropbear=m
CONFIG_PACKAGE_hostapd-utils=y
CONFIG_PACKAGE_iperf3=y
CONFIG_PACKAGE_iptables-nft=y
CONFIG_PACKAGE_iputils-arping=y
CONFIG_PACKAGE_iputils-ping=y
CONFIG_PACKAGE_kmod-ipt-core=y
CONFIG_PACKAGE_kmod-nf-ipt=y
CONFIG_PACKAGE_kmod-nft-compat=y
CONFIG_PACKAGE_kmod-veth=y
CONFIG_PACKAGE_libacl=y
CONFIG_PACKAGE_libatomic=y
CONFIG_PACKAGE_libattr=y
CONFIG_PACKAGE_libbz2=y
CONFIG_PACKAGE_libcbor=y
CONFIG_PACKAGE_libevdev=y
CONFIG_PACKAGE_libfido2=y
CONFIG_PACKAGE_libiperf3=y
CONFIG_PACKAGE_libiptext=y
CONFIG_PACKAGE_libiptext-nft=y
CONFIG_PACKAGE_libiptext6=y
CONFIG_PACKAGE_liblzma=y
CONFIG_PACKAGE_libncurses=y
CONFIG_PACKAGE_libopenssl=y
CONFIG_PACKAGE_libopenssl-conf=y
CONFIG_PACKAGE_libopenssl-legacy=y
CONFIG_PACKAGE_libpcap=y
CONFIG_PACKAGE_libpopt=y
CONFIG_PACKAGE_libpython3=y
CONFIG_PACKAGE_libstdcpp=y
CONFIG_PACKAGE_libudev-zero=y
CONFIG_PACKAGE_libxtables=y
CONFIG_PACKAGE_libzstd=y
CONFIG_PACKAGE_netperf=y
CONFIG_PACKAGE_openssh-keygen=y
CONFIG_PACKAGE_openssh-server=y
CONFIG_PACKAGE_procps-ng=y
CONFIG_PACKAGE_procps-ng-pkill=y
CONFIG_PACKAGE_python3-base=y
CONFIG_PACKAGE_python3-codecs=y
CONFIG_PACKAGE_python3-email=y
CONFIG_PACKAGE_python3-idna=y
CONFIG_PACKAGE_python3-light=y
CONFIG_PACKAGE_python3-urllib=y
CONFIG_PACKAGE_rsync=y
CONFIG_PACKAGE_sudo=y
CONFIG_PACKAGE_tar=y
CONFIG_PACKAGE_tcpdump=y
CONFIG_PACKAGE_terminfo=y
CONFIG_PACKAGE_wpa-cli=y
# CONFIG_PACKAGE_wpad-basic-mbedtls is not set
CONFIG_PACKAGE_wpad-openssl=y
CONFIG_PACKAGE_xtables-nft=y
CONFIG_PACKAGE_xz=y
CONFIG_PACKAGE_xz-utils=y
CONFIG_PACKAGE_zlib=y
CONFIG_RSYNC_acl=y
CONFIG_RSYNC_xattr=y
# CONFIG_TARGET_ROOTFS_INITRAMFS is not set
CONFIG_WPA_ENABLE_WEP=y
CONFIG_ZSTD_OPTIMIZE_O3=y
CONFIG_PACKAGE_cros-iperf=y
CONFIG_PACKAGE_cros-send-management-frame=y
```

## contrib/cros_openwrt_sources/image_generator/configs/BananaPi-R4/defconfig
```kconfig
CONFIG_TARGET_DEVICE_mediatek_filogic_DEVICE_bananapi_bpi-r4=y
# CONFIG_TARGET_DEVICE_mediatek_filogic_DEVICE_bananapi_bpi-r4-poe is not set
# CONFIG_TARGET_DEVICE_mediatek_filogic_DEVICE_bananapi_bpi-r4-lite is not set
# CONFIG_TARGET_DEVICE_mediatek_filogic_DEVICE_bananapi_bpi-r4-mini is not set
# CONFIG_TARGET_DEVICE_mediatek_filogic_DEVICE_bananapi_bpi-r4-pro is not set
# CONFIG_TARGET_DEVICE_mediatek_filogic_DEVICE_mediatek_mt7987a-rfb is not set
# CONFIG_TARGET_DEVICE_mediatek_filogic_DEVICE_mediatek_mt7988a-rfb is not set
# CONFIG_TARGET_DEVICE_mediatek_filogic_DEVICE_mediatek_mt7988d-rfb is not set

# CONFIG_PACKAGE_mt7981-wo-firmware is not set
# CONFIG_PACKAGE_mt7986-wo-firmware is not set
CONFIG_PACKAGE_mt7988-wo-firmware=y
CONFIG_PACKAGE_kmod-mt76qos=y
# CONFIG_PACKAGE_kmod-mt7915e is not set
# CONFIG_PACKAGE_kmod-mt7981-firmware is not set
# CONFIG_PACKAGE_kmod-mt7986-firmware is not set
CONFIG_PACKAGE_kmod-mt7990-firmware=y
CONFIG_PACKAGE_kmod-mt7992-23-firmware=y
CONFIG_PACKAGE_kmod-mt7992-firmware=y
CONFIG_PACKAGE_kmod-mt7996-233-firmware=y
CONFIG_PACKAGE_kmod-mt7996-firmware=y

# CONFIG_PACKAGE_dropbear is not set
CONFIG_PACKAGE_sudo=y
CONFIG_PACKAGE_python3-idna=y
CONFIG_PACKAGE_python3-urllib=y
CONFIG_PACKAGE_rsync=y
CONFIG_PACKAGE_openssh-server=y
CONFIG_WPA_ENABLE_WEP=y
CONFIG_PACKAGE_cros-iperf=y
CONFIG_PACKAGE_iputils-arping=y
CONFIG_PACKAGE_iputils-ping=y
CONFIG_PACKAGE_netperf=y
CONFIG_PACKAGE_cros-send-management-frame=y
CONFIG_PACKAGE_procps-ng=y
CONFIG_PACKAGE_procps-ng-pkill=y
CONFIG_PACKAGE_tar=y
CONFIG_DRIVER_11AC_SUPPORT=y
CONFIG_DRIVER_11AX_SUPPORT=y
CONFIG_WPA_MBO_SUPPORT=y
CONFIG_PACKAGE_tcpdump=y
CONFIG_BUSYBOX_CONFIG_TAR=y
CONFIG_PACKAGE_iperf3=y
CONFIG_BUSYBOX_CUSTOM=y
CONFIG_BUSYBOX_CONFIG_TIMEOUT=y
CONFIG_PACKAGE_libopenssl=y
CONFIG_PACKAGE_libopenssl-conf=y
CONFIG_PACKAGE_kmod-veth=y
CONFIG_PACKAGE_opennds=y
```

## contrib/cros_openwrt_sources/image_generator/configs/U6Lite/defconfig
```kconfig
CONFIG_TARGET_ramips=y
CONFIG_TARGET_ramips_mt7621=y
CONFIG_TARGET_ramips_mt7621_DEVICE_ubnt_unifi-6-lite=y
# CONFIG_KERNEL_DEBUG_INFO is not set
# CONFIG_LUCI_CSSTIDY is not set
# CONFIG_LUCI_JSMIN is not set
CONFIG_PACKAGE_dropbear=m
CONFIG_OPENSSL_ENGINE=y
CONFIG_OPENSSL_PREFER_CHACHA_OVER_GCM=y
CONFIG_OPENSSL_WITH_ASM=y
CONFIG_OPENSSL_WITH_CHACHA_POLY1305=y
CONFIG_OPENSSL_WITH_CMS=y
CONFIG_OPENSSL_WITH_DEPRECATED=y
CONFIG_OPENSSL_WITH_ERROR_MESSAGES=y
CONFIG_OPENSSL_WITH_IDEA=y
CONFIG_OPENSSL_WITH_MDC2=y
CONFIG_OPENSSL_WITH_PSK=y
CONFIG_OPENSSL_WITH_SEED=y
CONFIG_OPENSSL_WITH_SRP=y
CONFIG_OPENSSL_WITH_TLS13=y
CONFIG_OPENSSL_WITH_WHIRLPOOL=y
CONFIG_PACKAGE_TAR_BZIP2=y
CONFIG_PACKAGE_TAR_GZIP=y
CONFIG_PACKAGE_TAR_POSIX_ACL=y
CONFIG_PACKAGE_TAR_XATTR=y
CONFIG_PACKAGE_TAR_XZ=y
CONFIG_PACKAGE_TAR_ZSTD=y
CONFIG_PACKAGE_bzip2=y
CONFIG_PACKAGE_cros-iperf=y
CONFIG_PACKAGE_cros-send-management-frame=y
CONFIG_PACKAGE_hostapd-utils=y
CONFIG_PACKAGE_iperf3=y
CONFIG_PACKAGE_iptables-nft=y
CONFIG_PACKAGE_iputils-arping=y
CONFIG_PACKAGE_iputils-ping=y
CONFIG_PACKAGE_kmod-ipt-core=y
CONFIG_PACKAGE_kmod-nf-ipt=y
CONFIG_PACKAGE_kmod-nft-compat=y
CONFIG_PACKAGE_kmod-veth=y
CONFIG_PACKAGE_libacl=y
CONFIG_PACKAGE_libatomic=y
CONFIG_PACKAGE_libattr=y
CONFIG_PACKAGE_libbz2=y
CONFIG_PACKAGE_libiperf3=y
CONFIG_PACKAGE_libiptext=y
CONFIG_PACKAGE_libiptext-nft=y
CONFIG_PACKAGE_libiptext6=y
CONFIG_PACKAGE_liblzma=y
CONFIG_PACKAGE_libncurses=y
CONFIG_PACKAGE_libopenssl=y
CONFIG_PACKAGE_libopenssl-conf=y
CONFIG_PACKAGE_libopenssl-legacy=y
CONFIG_PACKAGE_libpcap=y
CONFIG_PACKAGE_libpython3=y
CONFIG_PACKAGE_libstdcpp=y
CONFIG_PACKAGE_libxtables=y
CONFIG_PACKAGE_libzstd=y
CONFIG_PACKAGE_netperf=y
CONFIG_PACKAGE_openssh-keygen=y
CONFIG_PACKAGE_openssh-server=y
CONFIG_PACKAGE_procps-ng=y
CONFIG_PACKAGE_procps-ng-pkill=y
CONFIG_PACKAGE_python3-base=y
CONFIG_PACKAGE_python3-codecs=y
CONFIG_PACKAGE_python3-email=y
CONFIG_PACKAGE_python3-idna=y
CONFIG_PACKAGE_python3-light=y
CONFIG_PACKAGE_python3-urllib=y
CONFIG_PACKAGE_sudo=y
CONFIG_PACKAGE_tar=y
CONFIG_PACKAGE_tcpdump=y
CONFIG_PACKAGE_terminfo=y
CONFIG_PACKAGE_wpa-cli=y
# CONFIG_PACKAGE_wpad-basic-mbedtls is not set
CONFIG_PACKAGE_wpad-openssl=y
CONFIG_PACKAGE_xtables-nft=y
CONFIG_PACKAGE_xz=y
CONFIG_PACKAGE_xz-utils=y
CONFIG_PACKAGE_zlib=y
# CONFIG_TARGET_ROOTFS_INITRAMFS is not set
# CONFIG_USE_MKLIBS is not set
# CONFIG_OPENSSH_LIBFIDO2 is not set
# CONFIG_PACKAGE_libcbor is not set
# CONFIG_PACKAGE_libevdev is not set
# CONFIG_PACKAGE_libfido2 is not set
# CONFIG_PACKAGE_libudev-zero is not set
CONFIG_WPA_ENABLE_WEP=y
CONFIG_PACKAGE_rsync=y
CONFIG_BUSYBOX_CUSTOM=y
CONFIG_BUSYBOX_CONFIG_TIMEOUT=y
```
